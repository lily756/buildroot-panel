## board/widora/mangopi/r3-aic8800d40/widora_mangopi_r3_aic8800d40_defconfig
```kconfig
BR2_arm=y
BR2_ARM_CPU_ARMV5=y

# Toolchain
BR2_TOOLCHAIN_BUILDROOT_GLIBC=y

# GCC Options
# No selected target package needs libstdc++; keeping a C-only userspace saves
# about 1 MiB in the NOR root filesystem.
BR2_GCC_ENABLE_LTO=y

# Host Config
BR2_PACKAGE_HOST_PYTHON3=y
BR2_PACKAGE_HOST_UBOOT_TOOLS=y
BR2_PACKAGE_HOST_UBOOT_TOOLS_FIT_SUPPORT=y
BR2_PACKAGE_HOST_DFU_UTIL=y

# Bootloader
BR2_TARGET_UBOOT=y
BR2_TARGET_UBOOT_BUILD_SYSTEM_KCONFIG=y
BR2_TARGET_UBOOT_CUSTOM_VERSION=y
BR2_TARGET_UBOOT_CUSTOM_VERSION_VALUE="2020.07"
BR2_TARGET_UBOOT_NEEDS_DTC=y
BR2_TARGET_UBOOT_FORMAT_BIN=y
BR2_TARGET_UBOOT_SPL=y
BR2_TARGET_UBOOT_USE_CUSTOM_CONFIG=y
BR2_TARGET_UBOOT_SPL_NAME="u-boot-sunxi-with-spl.bin"
BR2_TARGET_UBOOT_PATCH="board/allwinner/suniv-f1c100s/patch/u-boot board/widora/mangopi/r3-aic8800d40/patch/u-boot"

BR2_TARGET_UBOOT_CUSTOM_CONFIG_FILE="board/widora/mangopi/r3-aic8800d40/uboot.defconfig"
BR2_TARGET_UBOOT_CUSTOM_DTS_PATH="board/allwinner/suniv-f1c100s/devicetree/uboot/suniv-f1c100s.dtsi board/widora/mangopi/r3-aic8800d40/devicetree/uboot/suniv-f1c100s-generic.dts"

# Kernel
BR2_LINUX_KERNEL=y
BR2_PACKAGE_HOST_LINUX_HEADERS_CUSTOM_5_4=y
BR2_LINUX_KERNEL_CUSTOM_VERSION=y
BR2_LINUX_KERNEL_CUSTOM_VERSION_VALUE="5.4.99"
BR2_LINUX_KERNEL_DTS_SUPPORT=y
BR2_LINUX_KERNEL_USE_CUSTOM_CONFIG=y
BR2_LINUX_KERNEL_PATCH="board/allwinner/suniv-f1c100s/patch/linux board/widora/mangopi/r3-aic8800d40/patch/linux"

BR2_LINUX_KERNEL_CUSTOM_CONFIG_FILE="board/allwinner/suniv-f1c100s/linux.defconfig"
BR2_LINUX_KERNEL_CONFIG_FRAGMENT_FILES="board/widora/mangopi/r3-aic8800d40/linux-display-wifi.fragment"
BR2_LINUX_KERNEL_CUSTOM_DTS_PATH="board/allwinner/suniv-f1c100s/devicetree/linux/suniv-f1c100s.dtsi board/widora/mangopi/r3-aic8800d40/devicetree/linux/devicetree.dts"

# Filesystem
BR2_TARGET_ROOTFS_SQUASHFS=y
BR2_TARGET_ROOTFS_SQUASHFS4_XZ=y
# BR2_TARGET_ROOTFS_TAR is not set
BR2_PACKAGE_HOST_GENIMAGE=y
BR2_ROOTFS_POST_IMAGE_SCRIPT="board/widora/mangopi/r3-aic8800d40/post-image.sh"
BR2_ROOTFS_POST_SCRIPT_ARGS="${BR2_TARGET_UBOOT_SPL_NAME}"

BR2_ROOTFS_OVERLAY="board/allwinner/generic/rootfs board/allwinner/suniv-f1c100s/rootfs board/widora/mangopi/r3-aic8800d40/rootfs board/widora/mangopi/r3-aic8800d40/rootfs-overlay"
BR2_PACKAGE_BUSYBOX_CONFIG_FRAGMENT_FILES="board/widora/mangopi/r3-aic8800d40/busybox-wifi.fragment"

# Target Config
# The board scripts load the AIC modules explicitly. BusyBox mdev is enough for
# /dev population and avoids eudev plus its multi-megabyte hardware database.
BR2_ROOTFS_DEVICE_CREATION_DYNAMIC_MDEV=y

BR2_TARGET_GENERIC_ISSUE="Welcome to Widora MangoPi R3 AIC8800D40"
BR2_TARGET_GENERIC_HOSTNAME="mangopi-r3-aic8800d40"

# Target Package
BR2_PACKAGE_AIC8800_USB=y
BR2_PACKAGE_IW=y
BR2_PACKAGE_WIRELESS_REGDB=y
BR2_PACKAGE_IPTABLES=y
BR2_PACKAGE_HOSTAPD=y
# BR2_PACKAGE_HOSTAPD_DRIVER_HOSTAP is not set
BR2_PACKAGE_HOSTAPD_DRIVER_NL80211=y
# BR2_PACKAGE_HOSTAPD_ACS is not set
# BR2_PACKAGE_HOSTAPD_VLAN is not set
BR2_PACKAGE_DNSMASQ=y
# BR2_PACKAGE_DNSMASQ_TFTP is not set
BR2_PACKAGE_DNSMASQ_DHCP=y
BR2_PACKAGE_FB_TEST_APP=y
BR2_PACKAGE_WPA_SUPPLICANT=y
BR2_PACKAGE_WPA_SUPPLICANT_NL80211=y
BR2_PACKAGE_WPA_SUPPLICANT_CLI=y
BR2_PACKAGE_WPA_SUPPLICANT_PASSPHRASE=y
```

## package/aic8800-usb/Config.in
```kconfig
config BR2_PACKAGE_AIC8800_USB
	bool "AIC8800 USB Wi-Fi driver"
	depends on BR2_LINUX_KERNEL
	help
	  Out-of-tree USB Wi-Fi driver and firmware for AIC8800D40
	  modules.
	  The D40 USB ID is handled through the AIC8800D80 compatibility
	  firmware set.

comment "aic8800-usb needs a Linux kernel to be built"
	depends on !BR2_LINUX_KERNEL
```
